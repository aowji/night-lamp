## sdkconfig.defaults
```kconfig
CONFIG_IDF_TARGET="esp32s3"
# flash
CONFIG_ESPTOOLPY_FLASHSIZE_16MB=y
CONFIG_PARTITION_TABLE_CUSTOM=y
# PSRAM
CONFIG_SPIRAM=y
CONFIG_SPIRAM_MODE_OCT=y
# WIFI
CONFIG_ESP_WIFI_WAPI_PSK=y
CONFIG_ESP_WIFI_DPP_SUPPORT=y
```
